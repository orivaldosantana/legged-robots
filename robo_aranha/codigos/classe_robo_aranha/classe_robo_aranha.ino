// Sweep
// by BARRAGAN <http://barraganstudio.com> 
// This example code is in the public domain.


#include <Servo.h> 

#define trigPin 46
#define echoPin 42
#define numFastStates 17
#define NUM_SLOW_STATES 49
#define MXMT   12      /* indices 0-11, motores pino 2-13 */
 
Servo myservo[13];  // create servo object to control a servo 
                // a maximum of eight servo objects can be created 
 
int pos[13];    // variable to store the servo position 
int numMaxServo = 12;


int estado_onda_direito [NUM_SLOW_STATES][MXMT] = {{ -30 , -25 , -6 , -25 , -18 , -25 , 18 , 25 , 5 , 25 , 30 , 25 }, 
{ -26 , -12 , -6 , -25 , -18 , -25 , 17 , 25 , 5 , 25 , 29 , 25 }, 
{ -22 , 0 , -7 , -25 , -19 , -25 , 16 , 25 , 4 , 25 , 28 , 25 }, 
{ -18 , 12 , -8 , -25 , -20 , -25 , 15 , 25 , 3 , 25 , 27 , 25 }, 
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{ -30 , -25 , -6 , -25 , -18 , -25 , 18 , 25 , 5 , 25 , 30 , 25 }};

int statesSlowToLeft [NUM_SLOW_STATES][MXMT] = { { 0 , -25 , -24 , -25 , -12 , -25 , 12 , 25 , 24 , 25 , 0 , 25 }, 
{ -3 , -12 , -23 , -25 , -11 , -25 , 12 , 25 , 24 , 25 , 0 , 25 }, 
{ -7 , 0 , -22 , -25 , -10 , -25 , 13 , 25 , 25 , 25 , 1 , 25 }, 
{ -11 , 12 , -21 , -25 , -9 , -25 , 14 , 25 , 26 , 25 , 2 , 25 }, 
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{ 0 , -25 , -24 , -25 , -12 , -25 , 12 , 25 , 24 , 25 , 0 , 25 } };

int statesSlow [NUM_SLOW_STATES][MXMT] = {{ -45 , -30 , -9 , -30 , -27 , -30 , 18 , 30 , 36 , 30 , 0 , 30 }, 
{ -39 , -17 , -10 , -30 , -28 , -30 , 19 , 30 , 37 , 30 , 1 , 30 }, 
{ -33 , -5 , -11 , -30 , -29 , -30 , 20 , 30 , 38 , 30 , 2 , 30 }, 
{ -28 , 7 , -12 , -30 , -30 , -30 , 21 , 30 , 39 , 30 , 3 , 30 }, 
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{ -45 , -30 , -9 , -30 , -27 , -30 , 18 , 30 , 36 , 30 , 0 , 30 }};

int statesTurnToRight [numFastStates][12] = 
{{ -45 , -30 , 0 , -30 , -45 , -30 , 45 , 30 , 0 , 30 , 45 , 30 }, 
{ -39 , -17 , -5 , -30 , -39 , -17 , 39 , 30 , 5 , 17 , 39 , 30 }, 
{ -33 , -5 , -11 , -30 , -33 , -5 , 33 , 30 , 11 , 5 , 33 , 30 }, 
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{ -45 , -30 , 0 , -30 , -45 , -30 , 45 , 30 , 0 , 30 , 45 , 30 }};

int statesTurnToLeft  [numFastStates][12] = 
{{ 0 , -30 , -45 , -30 , 0 , -30 , 0 , 30 , 45 , 30 , 0 , 30 }, 
{ -5 , -17 , -39 , -30 , -5 , -17 , 5 , 30 , 39 , 17 , 5 , 30 }, 
{ -11 , -5 , -33 , -30 , -11 , -5 , 11 , 30 , 33 , 5 , 11 , 30 }, 
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{ 0 , -30 , -45 , -30 , 0 , -30 , 0 , 30 , 45 , 30 , 0 , 30 }};

 int estados [numFastStates][12] = {{ -45 , -30 , 0 , -30 , -45 , -30 , 0 , 30 , 45 , 30 , 0 , 30 }, 
{ -39 , -17 , -5 , -30 , -39 , -17 , 5 , 30 , 39 , 17 , 5 , 30 }, 
{ -33 , -5 , -11 , -30 , -33 , -5 , 11 , 30 , 33 , 5 , 11 , 30 }, 
{ -28 , 7 , -16 , -30 , -28 , 7 , 16 , 30 , 28 , -7 , 16 , 30 }, 
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{ -45 , -30 , 0 , -30 , -45 , -30 , 0 , 30 , 45 , 30 , 0 , 30 }};

class SpiderBot {
  int deleyFast;
  int deleySlow;
  int duration, distance;

  public: 
  
    SpiderBot() {
      deleyFast = 80; 
      deleySlow = 80;
    }
    
    void initialize() {
      pinMode(trigPin, OUTPUT);
      pinMode(echoPin, INPUT);
      /* robo v1 
      pos[0] = 95;
      pos[1] = 110;
      pos[2] = 90;
      pos[3] = 100;
      pos[4] = 70;
      pos[5] = 90;
      pos[6] = 75;
      pos[7] = 90;  
      pos[8] = 90;
      pos[9] = 115; 
      pos[10] = 100;
      pos[11] = 95; */
      // robo v1 
      pos[0] = 95;
      pos[1] = 95;
      pos[2] = 90;
      pos[3] = 75;
      pos[4] = 93;
      pos[5] = 95;
      pos[6] = 100;
      pos[7] = 85;  
      pos[8] = 87;
      pos[9] = 85; 
      pos[10] = 110;
      pos[11] = 70; 
      
      for (int i=0; i < numMaxServo; i++)
        myservo[i].attach(i+2);  // attaches the servo on pin i+2 to the servo object       
    }
    
    
    void goSlow() {
      for (int j=0; j < NUM_SLOW_STATES-1; j++) { // j identifica o estado 
        for (int i=0; i < numMaxServo; i++)
          myservo[i].write(pos[i] + statesSlow[j][i]);   
        delay(deleySlow);                    
      }
    } 
    
    void goSlowToLeft() {
      for (int j=0; j < NUM_SLOW_STATES-1; j++) { // j identifica o estado 
        for (int i=0; i < numMaxServo; i++)
          myservo[i].write(pos[i] + statesSlowToLeft[j][i]);   
        delay(deleySlow);                    
      }
    }     
    
    void goFast() {
      for (int j=0; j < numFastStates-1; j++) { // j identifica o estado 
        for (int i=0; i < numMaxServo; i++)
          myservo[i].write(pos[i] + estados[j][i]);              // tell servo to go to position in variable 'pos' 
        delay(deleyFast);                       // waits 15ms for the servo to reach the position  
      }
    } 
    
    void goFastToLeft() {
      for (int j=0; j < numFastStates-1; j++) { // j identifica o estado 
        for (int i=0; i < numMaxServo; i++)
          myservo[i].write(pos[i] + statesTurnToLeft[j][i]);       
        delay(deleyFast);                       
      }
    }   
  
    void goFastToRight() {
      for (int j=0; j < numFastStates-1; j++) { // j identifica o estado 
        for (int i=0; i < numMaxServo; i++)
          myservo[i].write(pos[i] + statesTurnToRight[j][i]);       
        delay(deleyFast);                       
      }
    }  
    
    
    int getDistance() {
 
      digitalWrite(trigPin, HIGH);
      delayMicroseconds(1000);
      digitalWrite(trigPin, LOW);
      duration = pulseIn(echoPin, HIGH);
      distance = (duration/2) / 29.1;
      if (distance >= 200 || distance <= 0){
        distance = 200; // Out of range
      }
      return distance; 
    }
      
};

SpiderBot roboAranha; 

void setup() 
{ 
  Serial.begin (9600);
  roboAranha.initialize();
  
} 
 
 
void loop() 
{  
  int distanceFrontObject = roboAranha.getDistance(); 
  
  

  if  (distanceFrontObject <30)
    roboAranha.goFastToLeft();
  else  if (distanceFrontObject <  100)
    roboAranha.goSlow();
  else  
    roboAranha.goFast(); 
 
}
